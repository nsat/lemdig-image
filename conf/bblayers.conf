## conf/bblayers.conf
```bitbake
# POKY_BBLAYERS_CONF_VERSION is increased each time build/conf/bblayers.conf
# changes incompatibly
POKY_BBLAYERS_CONF_VERSION = "2"

BBPATH = "${TOPDIR}"
BBFILES ?= ""

BBLAYERS ?= " \
  ${TOPDIR}/../meta \
  ${TOPDIR}/../meta-poky \
  ${TOPDIR}/../meta-yocto-bsp \
  ${TOPDIR}/../meta-openembedded/meta-oe \
  ${TOPDIR}/../meta-openembedded/meta-python \
  ${TOPDIR}/../meta-openembedded/meta-networking \
  ${TOPDIR}/../meta-spire \
  ${TOPDIR}/../meta-xilinx/meta-xilinx-bsp \
  ${TOPDIR}/../meta-adi/meta-adi-bsp \
  ${TOPDIR}/../meta-lemdig2 \
  ${TOPDIR}/../meta-lemsdr \
  "
```

## conf/local.conf
```bitbake
require conf/include/profile.inc

MACHINE = "marsupial-zynqmp"

PREFERRED_PROVIDER_virtual/kernel = "linux-adi"
PREFERRED_PROVIDER_virtual/bootbin ?= "bootbin-onthefly"
```

## meta-lemdig2/conf/layer.conf
```bitbake
# We have a conf and classes directory, add to BBPATH
BBPATH .= ":${LAYERDIR}"

# We have recipes-* directories, add to BBFILES
BBFILES += "${LAYERDIR}/recipes-*/*/*.bb \
            ${LAYERDIR}/recipes-*/*/*.bbappend"

BBFILE_COLLECTIONS += "lemdig2"
BBFILE_PATTERN_lemdig2 = "^${LAYERDIR}/"
LAYERDEPENDS_lemdig2 = "xilinx"
LAYERVERSION_lemdig2 = "4"
LAYERSERIES_COMPAT_lemdig2 = "sumo"

# Ignore some recipes from the meta-spire layer
BBMASK += "/meta-spire/recipes-core/base-files/"
```

## meta-lemdig2/conf/machine/marsupial-zynqmp.conf
```bitbake
#@TYPE: Machine
#@NAME: marsupial-zynqmp
#@DESCRIPTION: Machine support for LEMDIG1.5 "MARSUPIAL".

SOC_VARIANT ?= "eg"

require conf/machine/include/tune-zynqmp.inc
require conf/machine/include/machine-xilinx-overrides.inc
require conf/machine/include/machine-xilinx-default.inc
require conf/machine/include/machine-xilinx-board.inc
require conf/machine/include/machine-xilinx-qemu.inc
include conf/machine/include/zynqmp-pmu-config.inc

MACHINE_FEATURES = "rtc ext2 ext3 vfat"
UBOOT_MACHINE = "zynqmp_te0803_defconfig"
SERIAL_CONSOLE = "115200 ttyPS0"

# Disable serial consoles check to allow read-only rootfs
# (ref: https://lists.yoctoproject.org/pipermail/meta-xilinx/2018-January/003632.html)
SERIAL_CONSOLES_CHECK = ""

PREFERRED_PROVIDER_virtual/kernel ?= "linux-xlnx"
PREFERRED_PROVIDER_virtual/bootloader ?= "u-boot-xlnx"
PREFERRED_PROVIDER_virtual/pmu-firmware ?= "zynqmp-pmu-pmu-firmware"
PREFERRED_PROVIDER_virtual/bootbin ?= "bootbin-prebuilt"

EXTRA_IMAGEDEPENDS += " \
		arm-trusted-firmware \
		virtual/dtb \
		virtual/pmu-firmware \
		virtual/bootbin \
		"

# Enable creation of FIT images
KERNEL_CLASSES += "kernel-fitimage-lemdig"
# Use FIT image
KERNEL_IMAGETYPE = "fitImage"
# Specifify DTB to be included in FIT image
FIT_IMAGE_DEVICETREES = "zynqmp-te0803.dtb"
# Include an initramfs image
INITRAMFS_IMAGE = "lemdig-image-initramfs"



##############################################################################################################
#### QEMU configuration ######################################################################################

QB_MACHINE = "-machine xlnx-zcu102"
QB_MEM = "-m 2048"
# Ignore UART0 output and monitor UART1 (printing it to screen in QEMU)
QB_OPT_APPEND = "-nographic -serial null -serial mon:stdio"
QB_NETWORK_DEVICE = "-net nic -net nic -net nic -net nic,netdev=net0,macaddr=@MAC@"

# Use qemu-xilinx instead of mainline
PREFERRED_PROVIDER_qemu-helper-native = "qemu-xilinx-helper-native"

# Use the multiarch script instead of launching QEMU directly
QB_SYSTEM_NAME_append = "-multiarch"

# Replicate BootROM like behaviour, having loaded SPL and PMU(ROM+FW)
QB_OPT_APPEND_append_qemuboot-xilinx = " \
		-hw-dtb ${DEPLOY_DIR_IMAGE}/qemu-hw-devicetrees/multiarch/te0803-arm.dtb \
		${@qemu_zynqmp_unhalt(d, True)} \
		-device loader,file=${DEPLOY_DIR_IMAGE}/arm-trusted-firmware.elf,cpu-num=0 \
		-device loader,file=${DEPLOY_DIR_IMAGE}/u-boot.elf \
		"

# Attach the rootfs disk image to the second SD interface of QEMU (which is SD1), in EMMC mode.
# (Strangly, the kernel won't boot if the SD interface is not in EMMC mode)
# Also set the boot mode to "5" which corresponds to SD1 boot.
# Ref: "Mode Pins" @ https://wiki.trenz-electronic.de/display/PD/TE0803+TRM#TE0803TRM-BootProcess
QB_DEFAULT_FSTYPE_qemuboot-xilinx = "wic.qemu-sd"
QB_OPT_APPEND_append_qemuboot-xilinx = " -boot mode=5"
QB_ROOTFS_OPT_qemuboot-xilinx = " -drive if=sd,index=3,file=@ROOTFS@,format=raw \
                                  "
# PMU instance args
PMU_ROM ?= "${DEPLOY_DIR_IMAGE}/pmu-rom.elf"
QB_PMU_OPT = " \
		-M microblaze-fdt \
		-display none \
		-hw-dtb ${DEPLOY_DIR_IMAGE}/qemu-hw-devicetrees/multiarch/zynqmp-pmu.dtb \
		-kernel ${PMU_ROM} \
		-device loader,file=${DEPLOY_DIR_IMAGE}/pmu-firmware-${MACHINE}.elf \
		-device loader,addr=0xfd1a0074,data=0x1011003,data-len=4 \
		-device loader,addr=0xfd1a007C,data=0x1010f03,data-len=4 \
		"
QB_OPT_APPEND_append_qemuboot-xilinx = " -pmu-args '${QB_PMU_OPT}'"
```

## meta-lemdig2/scripts/lib/wic/canned-wks/lemdig-image-qemu.marsupial-zynqmp.wks
```
# short-description: Create SD card image with a boot partition
# long-description: Creates a partitioned SD card image. Boot files
# are located in the first vfat partition.

part /boot --source bootimg-partition --ondisk mmcblk0 --fstype=vfat --label boot --fsoptions=ro --active --align 4 --size 16
part / --source rootfs --ondisk mmcblk0 --fstype=ext4 --label root --fsoptions=ro --align 4

# Partition for program data (applications) that are upgradable by OOU
part /media/nand1_prog --ondisk mmcblk0 --fstype=ext4 --label prog --fsoptions=noatime --align 4096 --fixed-size 512

# Partition for general data, such as obsevation data
part /media/nand2_data --ondisk mmcblk0 --fstype=ext4 --label data --fsoptions=noatime --align 4096 --fixed-size 128
```

## meta-lemsdr/conf/layer.conf
```bitbake
# We have a conf and classes directory, add to BBPATH
BBPATH .= ":${LAYERDIR}"

# We have recipes-* directories, add to BBFILES
BBFILES += "${LAYERDIR}/recipes-*/*/*.bb \
            ${LAYERDIR}/recipes-*/*/*.bbappend"

BBFILE_COLLECTIONS += "lemsdr"
BBFILE_PATTERN_lemsdr = "^${LAYERDIR}/"
LAYERDEPENDS_lemsdr = "lemdig2 \
                        spire"
LAYERVERSION_lemsdr = "4"
# Yocto versions which this layer is compatible with:
LAYERSERIES_COMPAT_lemsdr = "sumo"
```

## meta-lemsdr/scripts/lib/wic/canned-wks/lemdig-image-bootstrap.marsupial-zynqmp.wks
```
# short-description: Create SD card image with a boot partition
# long-description: Creates a partitioned SD card image. Boot files
# are located in the first vfat partition.

part /boot --source bootimg-partition --ondisk mmcblk1 --fstype=vfat --label boot --fsoptions=ro --active --align 4 --fixed-size 32
```

## meta-lemsdr/scripts/lib/wic/canned-wks/lemdig-image-qemu.marsupial-zynqmp.wks
```
# short-description: Create SD card image with a boot partition
# long-description: Creates a partitioned SD card image. Boot files
# are located in the first vfat partition.

part /boot --source bootimg-partition --ondisk mmcblk0 --fstype=vfat --label boot --fsoptions=ro --active --align 4 --size 32
part / --source rootfs --ondisk mmcblk0 --fstype=ext4 --label root --fsoptions=ro --align 4

# datafs partition
part /media/sd1 --ondisk mmcblk0 --fstype=ext4 --label prog --fsoptions=noatime --align 4096 --fixed-size 512
```

## meta-spire/conf/distro/spire.conf
```bitbake
require conf/distro/poky.conf
# distro name
DISTRO = "spire"
DISTRO_NAME = "Spire Embedded Linux"
DISTRO_VERSION = "1.0"
DISTRO_CODENAME = "relentless"
MAINTAINER = "Spire Linux Team <spel@spire.com>"
```
